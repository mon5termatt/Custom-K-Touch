## firmware/main/Kconfig.projbuild
```kconfig
menu "Klipper Touch Configuration"

    config PP_WIFI_SSID
        string "WiFi SSID"
        default "myssid"
        help
            SSID (network name) the screen connects to.

    config PP_WIFI_PASSWORD
        string "WiFi password"
        default "mypassword"
        help
            WPA2 password for the WiFi network.

    config PP_PRINTER_HOST
        string "Default printer host (IP or hostname)"
        default "192.168.1.50"
        help
            Seed printer used when NVS is empty (skipped if left at the default
            placeholder). Prefer a Moonraker/Klipper host; PrusaLink and Bambu
            can still be added from the web UI.

    config PP_PRINTER_PORT
        int "Default printer port"
        default 7125
        help
            HTTP port for the seed printer. Moonraker is usually 7125; PrusaLink
            is usually 80.

    config PP_PRINTER_APIKEY
        string "Printer API key (optional)"
        default ""
        help
            Moonraker X-Api-Key, or PrusaLink API key. Leave blank if the host
            allows unauthenticated LAN clients (common for Moonraker).

    config PP_PRINTER_USER
        string "PrusaLink Digest username (fallback)"
        default "maker"
        help
            Used only for PrusaLink Digest auth when the API key is blank.

    config PP_PRINTER_PASSWORD
        string "PrusaLink Digest password (fallback)"
        default "changeme"
        help
            Used only for PrusaLink Digest auth when the API key is blank.

    config PP_STORAGE
        string "Default PrusaLink storage name"
        default "local"
        help
            Storage identifier used in /api/v1/files/<storage>/... for PrusaLink.
            Typically "local" (printer flash/SD) or "usb".

    config PP_POLL_INTERVAL_MS
        int "Status poll interval (ms)"
        default 1000
        range 200 10000
        help
            How often to poll printer status.

    config PP_UPDATE_REPO
        string "GitHub repo for auto-update (owner/name)"
        default "mon5termatt/Custom-K-Touch"
        help
            Releases of this GitHub repo are checked by the auto-updater. The latest
            release's .bin asset is downloaded and OTA-flashed on demand.

endmenu
```
